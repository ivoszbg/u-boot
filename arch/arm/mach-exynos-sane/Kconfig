## arch/arm/mach-exynos-sane/Kconfig
```kconfig
if ARCH_EXYNOS_SANE

config SYS_SOC
	default "exynos3475"

choice
	prompt "Exynos3475 board select"

config TARGET_XCOVER3VELTE
	bool "Sammy Xcover 3 Value Edition"
	help
	  Support for 96Board STiH410-B2260 based on STMicrolectronics
	  STiH410 soc. This board complies with 96Board Open Platform
	  Specifications. Features:
	  - 1GB DDR
	  - On-Board USB combo WiFi/Bluetooth RTL8723BU
	    with PCB soldered antenna
	  - Ethernet 1000-BaseT
	  - Sata
	  - HDMI
	  - 2 x USB2 type A
	  - micro USB2 type AB
	  - SD card slot
	  - High speed connector (SD/I2C/USB interfaces)
	  - Low speed connector (UART/I2C/GPIO/SPI/PCM interfaces)

endchoice

source "board/samsung/exynos3475-xcover3velte/Kconfig"

endif
```

## board/samsung/dream/Kconfig
```kconfig
if TARGET_DREAM

config SYS_BOARD
	default "dream"
	help
	  dream is a production board for Galaxy S8/S8+ phone on Exynos8895 SoC.

config SYS_VENDOR
	default "samsung"

config SYS_CONFIG_NAME
	default "dream"

config EXYNOS8895
    bool "Exynos 8895 SOC support"
    default "y"

endif
```

## board/samsung/exynos3475-xcover3velte/Kconfig
```kconfig
if TARGET_XCOVER3VELTE

config SYS_BOARD
	string
	default "exynos3475-xcover3velte"

config SYS_VENDOR
	string
	default "samsung"

config SYS_SOC
	string
	default "exynos3475"

config SYS_CONFIG_NAME
	string
	default "exynos3475-xcover3velte"

endif
```

## configs/dreamlte_defconfig
```kconfig
CONFIG_ARM=y
CONFIG_ARCH_EXYNOS=y
CONFIG_ARCH_EXYNOS9=y
CONFIG_S5P=y
CONFIG_TARGET_DREAM=y
CONFIG_DEFAULT_DEVICE_TREE="exynos8895-dreamlte"
# TODO fix the address since sboot is causing issues
CONFIG_SYS_TEXT_BASE=0x80001000
CONFIG_BOARD_EARLY_INIT_F=n
CONFIG_SKIP_LOWLEVEL_INIT=y
CONFIG_DISPLAY_CPUINFO=n
CONFIG_STANDALONE_LOAD_ADDR=0x10008000
CONFIG_SYS_MALLOC_F_LEN=0x8000
```

## configs/xcover3velte_defconfig
```kconfig
CONFIG_ARM=y
CONFIG_SKIP_LOWLEVEL_INIT=y
CONFIG_COUNTER_FREQUENCY=26000000
CONFIG_ARCH_EXYNOS_SANE=y
CONFIG_SYS_TEXT_BASE=0x20008000
CONFIG_SYS_MALLOC_LEN=0x5004000
CONFIG_SYS_MALLOC_F_LEN=0x400
CONFIG_NR_DRAM_BANKS=6
CONFIG_ENV_SIZE=0x4000
CONFIG_DEFAULT_DEVICE_TREE="exynos3475-xcover3velte"
CONFIG_DEBUG_UART_BASE=0x0
CONFIG_DEBUG_UART_CLOCK=10
CONFIG_IDENT_STRING="STMicroelectronics STiH410-B2260"
CONFIG_SYS_LOAD_ADDR=0x20000000
CONFIG_DEBUG_UART=y
CONFIG_DISTRO_DEFAULTS=y
CONFIG_FIT=y
CONFIG_FIT_VERBOSE=y
CONFIG_USE_BOOTARGS=y
# CONFIG_CONSOLE_MUX is not set
# CONFIG_DISPLAY_CPUINFO is not set
CONFIG_FDT_SIMPLEFB=y
CONFIG_SYS_PROMPT="exynos3475-xcover3velte => "
CONFIG_CMD_ASKENV=y
CONFIG_CMD_GPT=y
CONFIG_CMD_MMC=y
CONFIG_CMD_USB=y
CONFIG_CMD_TIME=y
CONFIG_CMD_TIMER=y
CONFIG_CMD_EXT4_WRITE=y
# CONFIG_ISO_PARTITION is not set
CONFIG_OF_CONTROL=y
CONFIG_SYS_RELOC_GD_ENV_ADDR=y
CONFIG_REGMAP=y
CONFIG_SYSCON=y
CONFIG_CLK=y
CONFIG_MISC=y
CONFIG_DM_ETH=y
CONFIG_PHY=y
CONFIG_SYSRESET=y
CONFIG_TIMER=y
CONFIG_USB=y
CONFIG_USB_XHCI_HCD=y
CONFIG_USB_XHCI_DWC3=y
CONFIG_USB_EHCI_HCD=y
CONFIG_USB_EHCI_GENERIC=y
CONFIG_USB_OHCI_HCD=y
CONFIG_USB_OHCI_GENERIC=y
CONFIG_USB_DWC3=y
CONFIG_USB_HOST_ETHER=y
CONFIG_USB_ETHER_ASIX=y
CONFIG_USB_ETHER_MCS7830=y
CONFIG_USB_ETHER_SMSC95XX=y
CONFIG_DM_VIDEO=y
CONFIG_VIDEO_SIMPLE=y
CONFIG_OF_LIBFDT_OVERLAY=y
```
