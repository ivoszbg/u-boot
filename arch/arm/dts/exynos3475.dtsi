// SPDX-License-Identifier: BSD-3-Clause
/*
 * Samsung's S5L8950X SoC device tree source
 *
 * Copyright (c) 2023, Ivaylo Ivanov <ivo.ivanov.ivanov1@gmail.com>
 */

#include <dt-bindings/interrupt-controller/arm-gic.h>
#include <dt-bindings/interrupt-controller/irq.h>

/ {
	//interrupt-parent = <&gic>;

	#address-cells = <2>;
	#size-cells = <2>;

	soc: soc {
		#address-cells = <1>;
		#size-cells = <1>;
		ranges = <0 0 0 0xffffffff>;
		compatible = "simple-bus";

		/* AIC v1 */

	};
};
